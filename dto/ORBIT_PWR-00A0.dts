
/dts-v1/; /* NOTE: the filename for your cape HAS to be: <part_number>-<version>.dts*/
/plugin/;

/* A good look at how to compile and implement a DTO: http://www.weigu.lu/sb-computer/bbb_device_tree/index.html */

/{
	compatible = "ti,beaglebone", "ti,beaglebone-black";
	part_number = "ORBIT_PWR"; /* Keep this name in mind */
	version = "00A0";
	
	/* this device overlay uses these pins (exclusively):*/
	exclusive-use = 
	/*I2C pins */
	"P9.24",	/* i2c1_SCL */
	"P9.26",	/* i2c1_SDA */
		
	"i2c1";

	fragment@0
	{
		target = <&am33xx_pinmux>;
		__overlay__ 
		{
			bb_i2c1_pins: pinmux_bb_i2c1_pins
			{ 
				/* the settings for the pins are set here*/
				pinctrl-single,pins = 
				<
					// set pin modes for i2c pins
					// for i2c pins on pin 24 & 26, use mode 3 (see user reference manual about modes)
					0x184 0x73 // P9_24 (PIN_INPUT_PULLUP | SLEWCTRL_FAST | MUX_MODE3)
					0x180 0x73 // P9_26 (PIN_INPUT_PULLUP | SLEWCTRL_FAST | MUX_MODE3)
                                >;
			};
		};
	};

	fragment@1 
	{
		target = <&i2c1>;       // i2c1 is numbered correctly
		__overlay__ 
		{
			status = "okay";
			pinctrl-names = "default";
			pinctrl-0 = <&bb_i2c1_pins>;

			// configuration start
			clock-frequency = <100000>;

			#address-cells = <1>;
			#size-cells = <0>;

			// add any i2c devices on the bus here
			// devices will be interfaced directly by programs in 
			// the usual case, so adding them here is unnessesary

			// commented out example of a touchscreen (taken from BB-BONE-LCD7-01-00A4)
			
			/*
			maxtouch@4a 
			{
				compatible = "mXT224";
				reg = <0x4a>;
				interrupt-parent = <&gpio4>;
				interrupts = <19 0x0>;
				atmel,irq-gpio = <&gpio4 19 0>;
			};
			*/
		};
	};
};
